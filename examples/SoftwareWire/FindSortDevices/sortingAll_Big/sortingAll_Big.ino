// ДАННЫЙ ПРИМЕР СОРТИРУЕТ АДРЕСА МОДУЛЕЙ ЛИНЕЙКИ FLASH I2C.                // * Строки со звёздочкой являются необязательными.
// Требуется установить библиотеку <iarduino_I2C_Software.h>                //   https://iarduino.ru/file/627.html
// Требуется установить библиотеку <iarduino_I2C_Address.h>                 //   https://iarduino.ru/file/558.html
//                                                                          //
// Допускается нахождение на шине модулей Flash I2C с одинаковыми адресами. //
// Допускается нахождение на шине сторонних устройств I2C.                  //
//                                                                          //
// - Пример sortingAll_Small только сортирует устройства.                   //
// - Пример sortingAll_Big   сортирует устройства и выводит информацию о них//
                                                                            //
const uint8_t sum = 10;                                                     //   Определяем количество модулей на шине I2C. Допускается указывать значение превышающее реальное количество модулей.
const uint8_t start = 0x20;                                                 //   Определяем первый адрес из списка создаваемых адресов для модулей Flash I2C.
                                                                            //
#include <iarduino_I2C_Software.h>                                          //   Подключаем библиотеку для работы с программной шиной I2C, до подключения библиотеки iarduino_I2C_Address.
SoftTwoWire sWire(3,4);                                                     //   Создаём объект программной шины I2C указав выводы которым будет назначена роль линий: SDA, SCL.
                                                                            //
#include <iarduino_I2C_Address.h>                                           //   Подключаем библиотеку для работы с адресами модулей линейки I2C-flash.
iarduino_I2C_Address obj[sum];                                              // * Объявляем  массив объектов (obj), указав количество (sum) модулей I2C-flash на шине I2C. Адреса модулей будут определены автоматически.
iarduino_I2C_SortAddress all;                                               //   Объявляем  объект (all) для сортировки адресов.
                                                                            //
void setup(){                                                               //
     delay(500);                                                            // * Ждём завершение переходных процессов связанных с подачей питания.
     Serial.begin(9600);                                                    //   Инициируем передачу данных в монитор последовательного порта на скорости 9600 бит/сек.
     while(!Serial){;}                                                      //   Ждём завершения инициализации шины UART.
                                                                            //
     Serial.println( F("-----------------") );                              // *
                                                                            //
//   НЕОБЯЗАТЕЛЬНЫЙ БЛОК ДЛЯ ВЫВОДА ИНФОРМАЦИИ О МОДУЛЯХ ДО СОРТИРОВКИ:     // *
                                                                            // *
//   Находим модули:                                                        // *
     Serial.print  ( F("Чтение... ") );                                     // *
     for(uint8_t i=0; i<sum; i++){ obj[i].begin(&sWire); } // &Wire...      //   Функция begin() принимает ссылку на объект для работы с шиной I2C и проверяет существование на этой шине очередного модуля.
     Serial.println( F("выполнено!") );                                     // * После begin(), результат обнаружения модуля остаётся доступным для чтения: if( obj[i] ){/*модуль был обнаружен*/;}else{/*нет*/;}
                                                                            // *
//   Выводим информацию о найденных модулях:                                // *
     for(uint8_t i=0; i<sum; i++){                                          // * Вместо цикла for() можно воспользоваться циклом while( obj[i] ){ ... i++; }
         if( obj[i] ){                                                      // * Если модуль не существует, то obj[i] вернёт false.
         //  Выводим порядковый номер модуля:                               // *
             Serial.print( i+1 ); Serial.print( F(".) ") );                 // *
         //  Выводим адрес модуля на шине I2C:                              // *
             Serial.print( F("0x") ); Serial.print( obj[i], HEX );          // *
         //  Выводим информацию о модуле:                                   // *
             if( obj[i].getDevice()==DEVICE_I2C_FLASH     ){ Serial.print( F(" Модуль Flash I2C «") ); Serial.print( obj[i].getName() ); Serial.print( F("»") ); }
             if( obj[i].getDevice()==DEVICE_I2C_FLASH_OLD ){ Serial.print( F(" Модуль Flash I2C без поддержки вывода названия и сортировки адреса.") ); }
             if( obj[i].getDevice()==DEVICE_I2C_UNKNOWN   ){ Serial.print( F(" Неизвестный модуль") ); }
             if( obj[i].getDevice()==DEVICE_I2C_DOUBLE    ){ Serial.print( F(" Адрес занят несколькими модулями")); }
         //  Переходим к следующему модулю:                                 // *
             Serial.println('.');                                           // *
         }                                                                  // *
     }                                                                      // *
                                                                            // *
//   СОРТИРОВКА:                                                            //
                                                                            //
//   Выполняем сортировку адресов:                                          //
     Serial.print( F("Сортировка... ") );                                   // *
     all.begin(&sWire); // &Wire, &Wire1, &Wire2 ...                        //   Функция begin() принимает ссылку на объект для работы с шиной I2C на которой требуется произвести сортировку адресов.
     if( all.sorting(start) ){ Serial.println( F("выполнено!"  ) ); }       //   Функция sorting() сортирует адреса всех устройств iarduino по порядку начиная с указанного адреса.
     else                    { Serial.println( F("не требуется") ); }       //   Функция sorting() возвращает true при успехе или false если возникла ошибка.
                                                                            //
//   НЕОБЯЗАТЕЛЬНЫЙ БЛОК ДЛЯ ВЫВОДА ИНФОРМАЦИИ О МОДУЛЯХ ПОСЛЕ СОРТИРОВКИ:  // *
                                                                            // *
//   Находим модули:                                                        // *
     Serial.print  ( F("Чтение... ") );                                     // *
     for(uint8_t i=0; i<sum; i++){ obj[i].begin(&sWire); } // &Wire...      //   Функция begin() принимает ссылку на объект для работы с шиной I2C и проверяет существование на этой шине очередного модуля.
     Serial.println( F("выполнено!") );                                     // * После begin(), результат обнаружения модуля остаётся доступным для чтения: if( obj[i] ){/*модуль был обнаружен*/;}else{/*нет*/;}
                                                                            // *
//   Выводим информацию о найденных модулях:                                // *
     for(uint8_t i=0; i<sum; i++){                                          // * Вместо цикла for() можно воспользоваться циклом while( obj[i] ){ ... i++; }
         if( obj[i] ){                                                      // * Если модуль не существует, то obj[i] вернёт false.
         //  Выводим порядковый номер модуля:                               // *
             Serial.print( i+1 ); Serial.print( F(".) ") );                 // *
         //  Выводим адрес модуля на шине I2C:                              // *
             Serial.print( F("0x") ); Serial.print( obj[i], HEX );          // *
         //  Выводим информацию о модуле:                                   // *
             if( obj[i].getDevice()==DEVICE_I2C_FLASH     ){ Serial.print( F(" Модуль Flash I2C «") ); Serial.print( obj[i].getName() ); Serial.print( F("»") ); }
             if( obj[i].getDevice()==DEVICE_I2C_FLASH_OLD ){ Serial.print( F(" Модуль Flash I2C без поддержки вывода названия и сортировки адреса.") ); }
             if( obj[i].getDevice()==DEVICE_I2C_UNKNOWN   ){ Serial.print( F(" Неизвестный модуль") ); }
             if( obj[i].getDevice()==DEVICE_I2C_DOUBLE    ){ Serial.print( F(" Адрес занят несколькими модулями")); }
         //  Переходим к следующему модулю:                                 // *
             Serial.println('.');                                           // *
         }                                                                  // *
     }                                                                      // *
}                                                                           //
                                                                            //
void loop(){                                                                //
}                                                                           //