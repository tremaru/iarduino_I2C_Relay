// ДАННЫЙ ПРИМЕР ИЩЕТ ВСЕ МОДУЛИ НА ШИНЕ I2C И ВЫВОДИТ ИНФОРМАЦИЮ О НИХ.    // * Строки со звёздочкой являются необязательными.
// Требуется установить библиотеку <iarduino_I2C_Address.h>                 //   https://iarduino.ru/file/558.html
//                                                                          //
// - Пример findDevices_Small  выводит короткую информацию о модулях.       //
// - Пример findDevices_Medium выводит количество и информацию о модулях.   //
// - Пример findDevices_Big    работает с модулями не выводящими название.  //
                                                                            //
const uint8_t sum = 10;                                                     //   Определяем количество модулей на шине I2C. Допускается указывать значение превышающее реальное количество модулей.
                                                                            //
#include <Wire.h>                                                           //   Подключаем библиотеку для работы с аппаратной шиной I2C, до подключения библиотеки iarduino_I2C_Address.
#include <iarduino_I2C_Address.h>                                           //   Подключаем библиотеку для работы с адресами модулей линейки I2C-flash.
iarduino_I2C_Address obj[sum];                                              //   Объявляем  массив объектов (obj), указав количество (sum) модулей I2C-flash на шине I2C. Адреса модулей будут определены автоматически.
                                                                            //   Если вам известны адреса модулей, то массив (obj) можно определить адресами, например: iarduino_I2C_Address obj[5]={10,20,12,54,67}.
void setup(){                                                               //
     delay(500);                                                            // * Ждём завершение переходных процессов связанных с подачей питания.
     Serial.begin(9600);                                                    //   Инициируем передачу данных в монитор последовательного порта на скорости 9600 бит/сек.
     while(!Serial){;}                                                      // * Ждём завершения инициализации шины UART.
                                                                            //
     Serial.println( F("-----------------") );                              // *
     Serial.print  ( F("Чтение... ") );                                     // *
                                                                            //
//   Находим модули:                                                        //
     for(uint8_t i=0; i<sum; i++){ obj[i].begin(&Wire); } // &Wire1...      //   Функция begin() принимает ссылку на объект для работы с шиной I2C и проверяет существование на этой шине очередного модуля.
                                                                            //   После begin(), результат обнаружения модуля остаётся доступным для чтения: if( obj[i] ){/*модуль был обнаружен*/;}else{/*нет*/;}
//   Сообщаем о завершении поиска модулей:                                  //
     Serial.println( F("выполнено!") );                                     // *
                                                                            //
//   Выводим адреса найденных модулей:                                      //
     for(uint8_t i=0; i<sum; i++){                                          //   Вместо цикла for() можно воспользоваться циклом while( obj[i] ){ ... i++; }
         if( obj[i] ){                                                      //   Если модуль не существует, то obj[i] вернёт false.
         //  Выводим порядковый номер модуля:                               //
             Serial.print( i+1                      );                      // * 
             Serial.print( F(".) 0x")               );                      //
         //  Выводим адрес модуля на шине I2C:                              //
             Serial.print( obj[i], HEX );                                   //
         //  Выводим короткую информацию о модуле:                          //
             if( obj[i].getDevice()==DEVICE_I2C_FLASH     ){ Serial.print( F(" Модуль Flash I2C «") ); Serial.print( obj[i].getName() ); Serial.print( F("»") ); }
             if( obj[i].getDevice()==DEVICE_I2C_FLASH_OLD ){ Serial.print( F(" Модуль Flash I2C"  ) ); }
             if( obj[i].getDevice()==DEVICE_I2C_UNKNOWN   ){ Serial.print( F(" Неизвестный модуль") ); }
             if( obj[i].getDevice()==DEVICE_I2C_DOUBLE    ){ Serial.print( F(" Адрес занят несколькими модулями")); }
         //  Переходим к следующему модулю:                                 //
             Serial.println('.');                                           //
         }                                                                  //
     }                                                                      //
                                                                            //
//   Информируем об отсутствии модулей на шине:                             //
     if( !obj[0] ){ Serial.println( F("Модули не найдены") ); }             // * Если нет первого модуля, значит нет и остальных.
}                                                                           //
                                                                            //
void loop(){                                                                //
}                                                                           //