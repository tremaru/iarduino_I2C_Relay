// ДАННЫЙ ПРИМЕР ЗАЩИЩАЕТ 3 И 4 КАНАЛЫ ОТ ПРЕВЫШЕНИЯ ТОКА:                    // * Строки со звёздочкой являются необязательными.
// Требуется установить библиотеку <iarduino_I2C_Software.h>                  //   https://iarduino.ru/file/627.html
                                                                              //
// Модуль силовых ключей 4N-канала 2А FLASH-I2C с измерением тока:            //   https://iarduino.ru/shop/Expansion-payments/power-key-4n-a-i2c.html
// Информация о модуле и описание библиотеки:                                 //   https://wiki.iarduino.ru/page/power-key-4n-a-i2c/
                                                                              //
// Модуль силовых ключей 4P-канала 2А FLASH-I2C с измерением тока:            //   https://iarduino.ru/shop/Expansion-payments/power-key-4p-a-i2c.html
// Информация о модуле и описание библиотеки:                                 //   https://wiki.iarduino.ru/page/power-key-4p-a-i2c/
                                                                              //
// Информация о подключении модулей к шине I2C:                               //   https://wiki.iarduino.ru/page/i2c_connection/
                                                                              //
#include <iarduino_I2C_Software.h>                                            //   Подключаем библиотеку для работы с программной шиной I2C, до подключения библиотеки iarduino_I2C_Relay.
SoftTwoWire sWire(3,4);                                                       //   Создаём объект программной шины I2C указав выводы которым будет назначена роль линий: SDA, SCL.
                                                                              //
#include <iarduino_I2C_Relay.h>                                               //   Подключаем библиотеку для работы с реле и силовыми ключами.
iarduino_I2C_Relay pwrkey(0x09);                                              //   Объявляем объект pwrkey для работы с функциями и методами библиотеки iarduino_I2C_Relay, указывая адрес модуля на шине I2C.
                                                                              //   Если объявить объект без указания адреса (iarduino_I2C_Relay pwrkey;), то адрес будет найден автоматически.
void setup(){                                                                 //
    Serial.begin(9600);                                                       //
    while(!Serial){;}                                                         // * Ждём завершения инициализации шины UART.
    delay(500);                                                               // * Ждём завершение переходных процессов связанных с подачей питания.
//  Готовим модуль к работе:                                                  //
    pwrkey.begin(&sWire);                                                     //   Инициируем работу с модулем, указав ссылку на объект для работы с шиной I2C на которой находится модуль (по умолчанию &Wire).
    pwrkey.digitalWrite(1,LOW);                                               // * Отключаем 1 канал модуля.
    pwrkey.digitalWrite(2,LOW);                                               // * Отключаем 2 канал модуля.
    pwrkey.digitalWrite(3,HIGH);                                              //   Включаем  3 канал модуля.
    pwrkey.digitalWrite(4,HIGH);                                              //   Включаем  4 канал модуля.
//  Устанавливаем защиту по току:                                             //
    pwrkey.setCurrentProtection(3, 1.0, CURRENT_LIMIT  );                     //   Включаем функцию ограничения тока до 1А на третьем канале.
    pwrkey.setCurrentProtection(4, 2.0, CURRENT_DISABLE);                     //   Включаем функцию отключения нагрузки при повышении тока выше 2А на четвёртом канале.
}                                                                             //   Если для одного канала включить сразу две функции, то будет работать только последняя.
                                                                              //
void loop(){                                                                  //
//  Проверяем выполняется ли функция ограничения тока, включенная на 3 канале //
    if( pwrkey.getCurrentProtection(3) ){                                     //   Если на третьем канале выполняется функция ограничения тока, то ...
        Serial.println("На 3 канале выполняется функция ограничения тока." ); //   Выводим сообщение о том что ток третьего канала ограничивается модулем при помощи ШИМ.
    }                                                                         //
//  Проверяем не отключена ли нагрузка на 4 канале в связи с превышением тока //
    if( pwrkey.getCurrentProtection(4) ){                                     //   Если на четвёртом канале выполнено отключение нагрузки в связи с превышением тока, то ...
        Serial.println("Нагрузка 4 канала отключена из-за превышения тока."); //   Выводи сообщение о том что нагрузка четвёртого канала отключена.
    //  Для восстановления работы нагрузки разкомментируйте следующие строки: //
    //  pwrkey.resCurrentProtection(4);                                       // * Перезапускаем защиту 4 канала.
    //  pwrkey.digitalWrite(4,HIGH);                                          // * Включаем 4 канал модуля (если ток по прежнему превышает указанные ранее 2А, то нагрузка вновь отключится).
    }                                                                         //
    delay(1000);                                                              //
}                                                                             //
                                                                              //
//  ПРИМЕЧАНИЕ:                                                               //
//  Если нагрузка канала отключена, то для её включения необходимо ...        //
//  - либо отключить     защиту функцией delCurrentProtection()               //
//  - либо перезапустить защиту функцией resCurrentProtection()               //
//  В противном случае канал останется отключённым.                           //